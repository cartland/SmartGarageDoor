## ESP32_FreeRTOS/main/Kconfig.projbuild
```kconfig
mainmenu "Smart Garage Door Configuration"

config PROJECT_DEVICE_ID
    string "Device ID"
    default "device_id"
    help
        Unique identifier for this device.

menu "WiFi Configuration"

    config ESP_WIFI_SSID
        string "WiFi SSID"
        default "YOUR_WIFI_SSID"
        help
            The SSID (name) of your Wi-Fi network.

    config ESP_WIFI_PASSWORD
        string "WiFi Password"
        default "YOUR_WIFI_PASSWORD"
        help
            The password for your Wi-Fi network.

    config ESP_MAXIMUM_RETRY
        int "Maximum Connection Retries"
        default 5
        help
            The maximum number of times to retry connecting to Wi-Fi.

    config ESP_WIFI_HOSTNAME
        string "WiFi Hostname"
        default "garage-door-esp32"
        help
            The hostname of the device on the network.

endmenu
```

## GarageFirmware_ESP32/main/Kconfig.projbuild
```kconfig
menu "Smart Garage Door Configuration"

    config GARAGE_SERVER_BASE_URL
        string "Garage Server Base URL"
        default "https://example.com"
        help
            The base URL of the garage server.

    config SENSOR_VALUES_ENDPOINT
        string "Sensor Values Endpoint"
        default "/sensor_values"
        help
            The endpoint to send sensor values to.

    config BUTTON_TOKEN_ENDPOINT
        string "Button Token Endpoint"
        default "/button_token"
        help
            The endpoint to get a button token from.

    config PROJECT_DEVICE_ID
        string "Device ID"
        default "device_id"
        help
            Unique identifier for this device.

endmenu

menu "WiFi Configuration"

    config ESP_WIFI_SSID
        string "WiFi SSID"
        default "YOUR_WIFI_SSID"
        help
            The SSID (name) of your Wi-Fi network.

    config ESP_WIFI_PASSWORD
        string "WiFi Password"
        default "YOUR_WIFI_PASSWORD"
        help
            The password for your Wi-Fi network.

    config ESP_MAXIMUM_RETRY
        int "Maximum Connection Retries"
        default 5
        help
            The maximum number of times to retry connecting to Wi-Fi.

    config ESP_WIFI_HOSTNAME
        string "WiFi Hostname"
        default "garage-door-esp32"
        help
            The hostname of the device on the network.

endmenu
```

## GarageFirmware_ESP32/sdkconfig.defaults
```kconfig
CONFIG_ESP_WIFI_SSID="SET_YOUR_WIFI_SSID"
CONFIG_ESP_WIFI_PASSWORD="SET_YOUR_WIFI_PASSWORD"
CONFIG_ESP_MAXIMUM_RETRY=10
CONFIG_PROJECT_DEVICE_ID="garage_device_id_123"
```
